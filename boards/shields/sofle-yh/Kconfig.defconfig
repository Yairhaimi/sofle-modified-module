## boards/shields/sofle-yh/Kconfig.defconfig
```kconfig
if SHIELD_SOFLE_YH_LEFT

# Name must be less than 16 characters long!
config ZMK_KEYBOARD_NAME
    default "Sofle YH"

config ZMK_SPLIT_ROLE_CENTRAL
    default y

endif

if SHIELD_SOFLE_YH_LEFT || SHIELD_SOFLE_YH_RIGHT

config ZMK_SPLIT
    default y

endif
```

## boards/shields/sofle-yh/Kconfig.shield
```kconfig
# No whitespace after the comma or in your part name!
config SHIELD_SOFLE_YH_LEFT
    def_bool $(shields_list_contains,sofle_yh_left)

# No whitespace after the comma or in your part name!
config SHIELD_SOFLE_YH_RIGHT
    def_bool $(shields_list_contains,sofle_yh_right)
```
